# https://gist.github.com/zobayer1/7265c698d1b024bb7723bc624aeedeb3

# ------------------------------------------------------------------------------
# SETTINGS
# ------------------------------------------------------------------------------

CC             = gcc
CXX            = g++

# ------------------------------------------------------------------------------
# Files and directories for the user code
# ------------------------------------------------------------------------------

# ------------------------------------------------------------------------------
# Platform specific flags
# ------------------------------------------------------------------------------

# ------------------------------------------------------------------------------
# Flags for gcc/binutils
# ------------------------------------------------------------------------------

# ------------------------------------------------------------------------------
# Files and directories for the system firmware
# ------------------------------------------------------------------------------

# ------------------------------------------------------------------------------
# Source compiling and dependency analysis
# ------------------------------------------------------------------------------

build:
	$(CC) main.c -o makeTest

# ------------------------------------------------------------------------------
# Object file conversion
# ------------------------------------------------------------------------------

# ------------------------------------------------------------------------------
# What to build
# ------------------------------------------------------------------------------

# ------------------------------------------------------------------------------
# Resources
# ------------------------------------------------------------------------------

# ------------------------------------------------------------------------------
# Main rules
# ------------------------------------------------------------------------------

# ------------------------------------------------------------------------------
# Bootloader merging
# ------------------------------------------------------------------------------

# ------------------------------------------------------------------------------
# Firmware flashing
# ------------------------------------------------------------------------------

# ------------------------------------------------------------------------------
# Cleaning up
# ------------------------------------------------------------------------------

clean:
	rm -R $(TARGET)

# ------------------------------------------------------------------------------
# Other
# ------------------------------------------------------------------------------

.PHONY: build clean

# ------------------------------------------------------------------------------
# from the simple version
# ------------------------------------------------------------------------------

# build:
# 	gcc main.c -o makeTest

# clean:
# 	rm -R makeTest

# .PHONY: build clean
